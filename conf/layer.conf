## conf/layer.conf
```bitbake
# We have a conf and classes directory, add to BBPATH
BBPATH .= ":${LAYERDIR}"

# We have recipes-* directories, add to BBFILES
BBFILES += "${LAYERDIR}/recipes-*/*/*.bb \
            ${LAYERDIR}/recipes-*/*/*.bbappend"

BBFILE_COLLECTIONS += "meta-imx8mp-debix"
BBFILE_PATTERN_meta-imx8mp-debix = "^${LAYERDIR}/"
BBFILE_PRIORITY_meta-imx8mp-debix = "6"

LAYERDEPENDS_meta-imx8mp-debix = "core"
LAYERSERIES_COMPAT_meta-imx8mp-debix = "kirkstone"
```

## conf/machine/imx8mp-debix.conf
```bitbake
#@TYPE: Machine
#@NAME: NXP i.MX 8M Plus Debix Evaluation Kit
#@SOC: i.MX8MP
#@DESCRIPTION: Machine configuration for NXP i.MX 8M Plus Debix Evaluation Kit
#@MAINTAINER: Joris Offouga <offougajoris@gmail.com>

MACHINEOVERRIDES =. "mx8mp:"

# FIXME: u-boot-imx should be converted to `binman` and then we can
# avoid this specific overrides and handle it in a generic way.
MACHINEOVERRIDES =. "${@bb.utils.contains('IMX_DEFAULT_BOOTLOADER', 'u-boot-imx', '', 'imx-boot-container:', d)}"

require conf/machine/include/imx-base.inc
require conf/machine/include/arm/armv8a/tune-cortexa53.inc

MACHINE_FEATURES:append = " pci wifi bluetooth rtc usbgadget usbhost"
MACHINE_FEATURES:append = " optee"

KERNEL_DEVICETREE_BASENAME = "imx8mp-debix"

KERNEL_DEVICETREE = " \
    freescale/${KERNEL_DEVICETREE_BASENAME}.dtb \
"

UBOOT_DTB_NAME = "${KERNEL_DEVICETREE_BASENAME}.dtb"

IMX_DEFAULT_BOOTLOADER:use-nxp-bsp = "u-boot-imx"

UBOOT_SUFFIX = "bin"

UBOOT_CONFIG = "sd"
UBOOT_CONFIG[sd] = "imx8mp_debix_defconfig,sdcard"

SPL_BINARY = "spl/u-boot-spl.bin"

ATF_PLATFORM = "imx8mp"

IMX_BOOT_SOC_TARGET = "iMX8MP"

SERIAL_CONSOLES = "115200;ttymxc1"

UBOOT_EXTLINUX ?= "1"
UBOOT_EXTLINUX_FDT = "../${KERNEL_DEVICETREE_BASENAME}.dtb"
UBOOT_EXTLINUX_CONSOLE = "console=${console},${baudrate}"
UBOOT_EXTLINUX_ROOT = "root=/dev/mmcblk0p2"

# Add extlinux.conf and in case of EXTLINUX are disabled to the lis of files, which are deployed onto the
# boot partition
IMAGE_BOOT_FILES:append = " \
    ${@bb.utils.contains('UBOOT_EXTLINUX', '1', 'extlinux.conf;extlinux/extlinux.conf', '',d)} \
"

LOADADDR = ""
UBOOT_MAKE_TARGET = "all"
IMX_BOOT_SEEK = "32"

OPTEE_BIN_EXT = "8mp"
TEE_LOAD_ADDR = "0x56000000"

# Add additional firmware for wifi
MACHINE_FIRMWARE:append = " linux-firmware-bcm43455"

# Set DDR FIRMWARE
DDR_FIRMWARE_VERSION = "202006"
DDR_FIRMWARE_NAME = " \
    lpddr4_pmu_train_1d_dmem_${DDR_FIRMWARE_VERSION}.bin \
    lpddr4_pmu_train_1d_imem_${DDR_FIRMWARE_VERSION}.bin \
    lpddr4_pmu_train_2d_dmem_${DDR_FIRMWARE_VERSION}.bin \
    lpddr4_pmu_train_2d_imem_${DDR_FIRMWARE_VERSION}.bin \
"

IMXBOOT_TARGETS = "flash_evk"
IMX_DEFAULT_BSP = "nxp"
```
